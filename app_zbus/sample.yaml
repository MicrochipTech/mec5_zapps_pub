## app_zbus/sample.yaml
```yaml
# This file is provided so that the application can be compiled using Twister,
# the Zephyr testing tool. In this file, multiple combinations can be specified,
# so that you can easily test all of them locally or in CI.
sample:
  description: Example ZBUS application
  name: example-zbus-application
common:
  build_only: true
  platform_allow:
    - mec_assy6906_mech1723nlj
    - mec_assy6906_mech1723nsz
    - mec_assy6941_mec1743qlj
    - mec_assy6941_mec1743qsz
    - mec_assy6941_mec1753qlj
    - mec_assy6941_mec1753qsz
tests:
  app.default: {}
  app.debug:
    extra_overlay_confs:
      - debug.conf
```

## drivers/Kconfig
```kconfig
# Copyright (c) 2021 Nordic Semiconductor ASA
# SPDX-License-Identifier: Apache-2.0

menu "Drivers"
rsource "blink/Kconfig"
rsource "sensor/Kconfig"
rsource "flash/Kconfig"
rsource "i2c/Kconfig"
endmenu
```

## drivers/flash/Kconfig
```kconfig
# Copyright (c) 2025 Microchip Technology Inc.
# SPDX-License-Identifier: Apache-2.0

if FLASH
rsource "Kconfig.mec5"
endif # FLASH
```

## drivers/flash/Kconfig.mec5
```kconfig
# Copyright (c) 2025 Microchip Technology Inc.
# SPDX-License-Identifier: Apache-2.0

menuconfig FLASH_MCHP_MEC5_QSPI_NOR
	bool "Microchip MEC5 QSPI flash controller driver for SPI NOR flashes"
	default y
	depends on DT_HAS_MICROCHIP_MEC5_QSPI_FLASH_CONTROLLER_ENABLED
	select FLASH_HAS_DRIVER_ENABLED
	select FLASH_JESD216
	select PINCTRL
	help
	  Enable this option to use the Microchip MEC5 QSPI flash controller driver.

# depends on DT_HAS_MICROCHIP_MEC5_QSPI_CTRL_ENABLED
# depends on DT_HAS_MICROCHIP_MEC5_QSPI_FC_ENABLED
# select FLASH_HAS_PAGE_LAYOUT
# select FLASH_JESD216
```

## drivers/i2c/Kconfig
```kconfig
# Copyright (c) 2025 Microchip Technology Inc.
# SPDX-License-Identifier: Apache-2.0

if I2C
rsource "Kconfig.mec5"
endif # I2C
```

## drivers/i2c/Kconfig.mec5
```kconfig
# Copyright (c) 2025 Microchip Technology Inc.
# SPDX-License-Identifier: Apache-2.0

config MCHP_MEC5_I2C_NL
	bool "Microchip MEC5 I2C Network Layer driver using direct HAL DMA"
	default y
	depends on DT_HAS_MICROCHIP_MEC5_I2C_NL_ENABLED
	select EVENTS
	select DMA
	help
	  Enable this option to use the Microchip MEC5 I2C with Network Layer
	  plus DMA provided by the Zephyr DMA driver.
```

## drivers/sensor/Kconfig
```kconfig
# Copyright (c) 2021 Nordic Semiconductor ASA
# SPDX-License-Identifier: Apache-2.0

if SENSOR
rsource "example_sensor/Kconfig"
rsource "microchip/Kconfig"
endif # SENSOR
```

## drivers/sensor/microchip/Kconfig
```kconfig
# Copyright (c) 2024 Analog Devices, Inc.
# SPDX-License-Identifier: Apache-2.0

# zephyr-keep-sorted-start
rsource "tach_mec5_cct/Kconfig"
# zephyr-keep-sorted-stop
```

## drivers/sensor/microchip/tach_mec5_cct/Kconfig
```kconfig
# Microchip MEC5 HAL based input capture compare timer as a tachometer sensor

# Copyright (c) 2025 Microchip Technology Inc.
# SPDX-License-Identifier: Apache-2.0

config TACH_MCHP_MEC5_CCT_CAP
	bool "Microchip MEC5 HAL based CCT capture"
	default y
	depends on DT_HAS_MICROCHIP_MEC5_TACH_CCT_CAP_ENABLED
	depends on SOC_FAMILY_MICROCHIP_MEC
	depends on HAS_MEC5_HAL
	select PINCTRL
	select EVENTS
	help
	  Enable the Microchip MEC5 HAL based CCT capture hardware for
	  use as a tachometer.
```

## dts/bindings/flash_controller/microchip,mec5-qspi-ctrl.yaml
```yaml
# Copyright (c) 2020, Linaro limited
# Copyright (c) 2025, Microchip Technology Inc.
# SPDX-License-Identifier: Apache-2.0

description: |
    Microchip QSPI flash controller device representation. A qspi node would typically
    look like this:

        &qspi0 {
            pinctrl-0 = < &qspi_shd_cs0_n_gpio055 &qspi_shd_clk_gpio056
                          &qspi_shd_io0_gpio223 &qspi_shd_io1_gpio224
                          &qspi_shd_io2_gpio227 &qspi_shd_io3_gpio016 >;

            status = "okay";
        };

compatible: "microchip,mec5-qspi-ctrl"

include: [flash-controller.yaml, pinctrl-device.yaml]

bus: qspi

properties:
  interrupts:
    required: true

  pinctrl-0:
    required: true

  pinctrl-names:
    required: true

child-binding:
  description: Microchip SPI flash port

  include: microchip,qspi-nor-device.yaml
```

## dts/bindings/flash_controller/microchip,mec5-qspi-flash-controller.yaml
```yaml
# Copyright (c) 2025 Microchip Technology Inc.
# SPDX-License-Identifier: Apache-2.0

description: Microchip MEC5 flash driver using QSPI controller

compatible: "microchip,mec5-qspi-flash-controller"

include: [flash-controller.yaml, pinctrl-device.yaml]

bus: qspi

properties:
  interrupts:
    required: true

  pinctrl-0:
    required: true

  pinctrl-names:
    required: true

  qspi-frequency:
    type: int
    required: true
    description: |
      Default frequency in Hz for both chip selects. The flash device child nodes
      can override this value.

  signal-mode:
    type: string
    enum:
      - "SPI_MODE_0"
      - "SPI_MODE_1"
      - "SPI_MODE_2"
      - "SPI_MODE_3"
    description:
      SPI signalling mode specifying idle state of SPI clock and the clock edges
      for driving transmit data and sampling receive data. The default mode is SPI_MODE_0.

      For SPI Modes 0 and 3 the controller samples receive data on the clock rising edge
      and transmit data is driven on the clock falling edge. Mode 0 idle clock state is low
      whereas Mode 3 idle clock state is high.
```

## dts/bindings/i2c/microchip,mec5-i2c-nl.yaml
```yaml
# Copyright (c) 2025 Microchip Technology Inc.
# SPDX-License-Identifier: Apache-2.0

description: Microchip MEC5 I2C using HW network layer and HAL DMA

compatible: "microchip,mec5-i2c-nl"

include: [i2c-controller.yaml, pinctrl-device.yaml, base.yaml]

properties:
  reg:
    required: true

  pinctrl-0:
    required: true

  pinctrl-names:
    required: true

  port_sel:
    type: int
    description: Port MUX number matching pinctrl-0 pins
    required: true

  scl-gpios:
    type: phandle-array
    description: I2C clock line gpio handle and flags
    required: true

  sda-gpios:
    type: phandle-array
    description: I2C data line gpio handle and flags
    required: true

  dmas:
    required: true
    description: |
      TX and RX DMA specifiers. Each specifier has a phandle reference
      to the DMA channel, the channel number, and a peripheral trigger source.

      Example using DMA channels 2 and 3 for controller/target modes on I2C controller 1.
        dmas = <&dmac 2 0x03>, <&dmac 3 0x2>;

  dma-names:
    required: true
    description:
      Required for the dmas property. The names should be "cm" for controller mode
      and "tm" for target mode.

      Example
        dma-names = "cm", "tm";

  init-pin-wait:
    type: int
    default: 100
    description: |
      Amount of time in microseconds to delay allowing the controller to sample the
      I2C lines during driver initialization. If not present the default is 100 us.

  config-pin-wait:
    type: int
    default: 35000
    description: |
      Amount of time in microseconds to delay allowing the controller to sample the
      I2C lines after controller is configured. This delay is used by the configure
      API and port switch API. If not present the default is 35000 us (SMBus timeout).

  cm-tx-buf-size:
    type: int
    default: 64
    description: |
      Controller mode driver transmit buffer size in bytes.
      I2C network layer hardware uses DMA to transfer data including the target
      address from memory to the hardware. Data flow includes target addresses for
      (RPT)-START and PEC checksum if enabled. The driver uses this buffer to build
      the transmit packet.

  tm-rx-buf-size:
    type: int
    default: 64
    description: |
      Driver buffer for receiving data from an external Controller in target mode.
```

## dts/bindings/mtd/microchip,mec5-qspi-nor-device.yaml
```yaml
# Copyright 2025 Microchip Technology Inc.
# SPDX-License-Identifier: Apache-2.0

description: Microchip QSPI NOR flash device

compatible: "microchip,mec5-qspi-nor-device"

include: ["base.yaml", "jedec,spi-nor-common.yaml"]

on-bus: qspi

properties:
  reg:
    required: true
    description: Reg base address used for specifying chip select. Allowed values are 0 or 1.

  qspi-max-frequency:
    type: int
    required: true
    description: Maximum SPI clock frequency this flash device can tolerate.

  use-dual:
    type: boolean
    description: If set prefer Dual SPI commands over Quad.
```

## dts/bindings/qspi/microchip,mec5-qspi-fc.yaml
```yaml
# Copyright (c) 2020, Linaro limited
# Copyright (c) 2025, Microchip Technology Inc.
# SPDX-License-Identifier: Apache-2.0

description: |
    Microchip QSPI flash controller device representation. A qspi node would typically
    looks to this:

        &qspi0 {
            pinctrl-0 = <&quadspi_clk_pe10 &quadspi_ncs_pe11
                         &quadspi_bk1_io0_pe12 &quadspi_bk1_io1_pe13
                         &quadspi_bk1_io2_pe14 &quadspi_bk1_io3_pe15>;

            status = "okay";
        };

compatible: "microchip,mec5-qspi-fc"

include: [base.yaml, pinctrl-device.yaml]

bus: qspi

properties:
  reg:
    required: true

  interrupts:
    required: true

  pinctrl-0:
    required: true

  pinctrl-names:
    required: true
```

## dts/bindings/tach/microchip,mec5-tach-cct-cap.yaml
```yaml
# Copyright (c) 2025, Microchip Technology Inc.
# SPDX-License-Identifier: Apache-2.0

description: |
  Microchip MEC5 HAL based tachometer using capture compare timer capture units

compatible: "microchip,mec5-tach-cct-cap"

# NOTE: tach.yaml defines bus tach

include: [tach.yaml, pinctrl-device.yaml]

properties:
  reg:
    required: true

  interrupts:
    required: true

  interrupt-names:
    required: true

  pinctrl-0:
    required: true

  pinctrl-names:
    required: true

  freerun-clk:
    required: true
    type: string
    enum:
      - "48M"
      - "24M"
      - "12M"
      - "6M"
      - "3M"
      - "1500K"
      - "750K"
      - "375K"

child-binding:
  description: Capture units configurations.

  properties:
    reg:
      type: int
      required: true
      enum:
        - 0
        - 1
        - 2
        - 3
        - 4
        - 5

      description: |
        Capture counter ID in [0, 5]

    edge-detect:
      type: string
      enum:
        - "falling edges"
        - "rising edges"
        - "both edges"

      description: |
        Capture unit will store the current freerun counter value when the trigger
        input edge event occurs. Sofware must read this value before the next edge
        or it will be overwritten. If this property is not present edge detection
        will be disabled resulting in the capture register not updated.

    filter-clk:
      type: string
      required: true
      enum:
        - "48M"
        - "24M"
        - "12M"
        - "6M"
        - "3M"
        - "1500K"
        - "750K"
        - "375K"

      description: |
        Enable input signal filter. The input signal must remain stable for three
        clocks of the selected frequency before an edge will be registered.
        Choose filter clock to be at least 4X the duration of the input signal pulse
        width.

    filter-bypass:
      type: boolean
      description: |
        Bypass the input filter. When bypass is enabled the filter clock must
        be at least 2X the duration of the input signal pulse to be reliably
        detected.

    input-mux:
      type: int
      required: true
      enum:
        - 0
        - 1
        - 2
        - 3
        - 4
        - 5
        - 6
        - 7
        - 8
        - 9
        - 10
        - 11
        - 12
        - 13
        - 14
        - 15

      description: |
        Select one of 16 input signals to capture edges. Multiple capture
        units can be connected to the same signal. Please refer the chip
        documentation for the pins connected to CCT capture inputs. These pins
        must be present in the pinctrl-0 list for this device.
```

## dts/bindings/tach/microchip,mec5-tach-cct.yaml
```yaml
# Copyright (c) 2025, Microchip Technology Inc.
# SPDX-License-Identifier: Apache-2.0

description: Microchip MEC5 HAL based tachometer using capture compare timer

compatible: "microchip,mec5-tach-cct"

include: [tach.yaml, pinctrl-device.yaml]

properties:
  reg:
    required: true

  interrupts:
    required: true

  compare-channels:
    type: array
    required: true
    description: |
      CCT implements six comparators and HW MUX assigning any of 16 pins
      to each comparator. This property is an array of up to six integers.
      Position in the array specifies the comparator and the value specifies
      the input pin [0, 15]. Any value > 15 indicates the comarator is not
      used.
```

## west.yml
```yaml
# Copyright (c) 2021 Nordic Semiconductor ASA
# Copyright (c) 2024 Microchip Technology Inc.
# SPDX-License-Identifier: Apache-2.0

manifest:
  self:
    west-commands: scripts/west-commands.yml

  remotes:
    - name: origin
      url-base: https://github.com/MicrochipTech
    - name: upstream
      url-base: https://github.com/zephyrproject-rtos

  projects:
    - name: zephyr
      remote: origin
      revision: devel_mec5_all_updates
      import:
        # By using name-allowlist we can clone only the modules that are
        # strictly needed by the application.
        name-allowlist:
          - cmsis      # required by the ARM port
          - cmsis_6
    - name: hal_microchip
      path: modules/hal/microchip
      remote: origin
      revision: master
```
