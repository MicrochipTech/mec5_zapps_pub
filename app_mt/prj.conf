## CMakeLists.txt
```
#-------------------------------------------------------------------------------
# Zephyr Example Application
#
# Copyright (c) 2025 Microchip Technology Inc.
# SPDX-License-Identifier: Apache-2.0

cmake_minimum_required(VERSION 3.13.1)
find_package(Zephyr REQUIRED HINTS $ENV{ZEPHYR_BASE})

project(app LANGUAGES C)

target_sources(app PRIVATE src/main.c)
target_sources_ifdef(CONFIG_USE_APP_THREAD1 app PRIVATE src/app_thread1.c)
target_sources_ifdef(CONFIG_USE_APP_THREAD2 app PRIVATE src/app_thread2.c)
```

## Kconfig
```
# Copyright (c) 2025 Microchip Technology Inc.
# SPDX-License-Identifier: Apache-2.0
#
# This file is the application Kconfig entry point. All application Kconfig
# options can be defined here or included via other application Kconfig files.
# You can browse these options using the west targets menuconfig (terminal) or
# guiconfig (GUI).

menu "Zephyr"
source "Kconfig.zephyr"
endmenu

module = APP
module-str = APP
source "subsys/logging/Kconfig.template.log_config"

rsource "Kconfig.app_threads"
```

## Kconfig.app_threads
```
# Copyright (c) 2025 Microchip Technology Inc.
# SPDX-License-Identifier: Apache-2.0
#
# Kconfig.app_threads
# Zephyr thread parameters
#

config USE_APP_THREAD1
	bool "Enable application thread 1"
	default y

config USE_APP_THREAD2
	bool "Enable application thread 2"
	default y

if USE_APP_THREAD1

config APP_THREAD1_STACK_SIZE
	int "Thread 1 stack size in bytes"
	default 1024
	help
	  Application thread 1 stack size in bytes.
	  Default is 1024. Minimum is 256.

config APP_THREAD1_PRIORITY
	int "Thread 1 priority"
	default 5
	help
	  Application thread 1 default priority.
	  Default is 5. Zephyr thread priorities can be negative or postive.
	  Numerically lower priorities take precedence over numerically higher values.

endif # USE_APP_THREAD1

if USE_APP_THREAD2

config APP_THREAD2_STACK_SIZE
	int "Thread 2 stack size in bytes"
	default 1024
	help
	  Application thread 2 stack size in bytes.
	  Default is 1024. Minimum is 256.

config APP_THREAD2_PRIORITY
	int "Thread 2 priority"
	default 7
	help
	  Application thread 2 default priority.
	  Default is 7. Zephyr thread priorities can be negative or postive.
	  Numerically lower priorities take precedence over numerically higher values.

endif # USE_APP_THREAD2
```

## sample.yaml
```
# This file is provided so that the application can be compiled using Twister,
# the Zephyr testing tool. In this file, multiple combinations can be specified,
# so that you can easily test all of them locally or in CI.
sample:
  description: Example application creating multiple threads
  name: example-mt-application
common:
  build_only: true
  platform_allow:
    - mec_assy6906/mech1723_nlj
    - mec_assy6906/mech1723_nsz
    - mec_assy6941/mec1743_qlj
    - mec_assy6941/mec1743_qsz
    - mec_assy6941/mec1753_qlj
    - mec_assy6941/mec1753_qsz
tests:
  app.default: {}
  app.debug:
    extra_overlay_confs:
      - debug.conf
```

## prj.conf
```kconfig
# Copyright (c) 2025 Microchip Technology Inc.
# SPDX-License-Identifier: Apache-2.0
#
# This file contains selected Kconfig options for the application.

CONFIG_LOG=y
CONFIG_LOG_MODE_IMMEDIATE=y
CONFIG_LOG_BACKEND_UART=y

CONFIG_MAIN_THREAD_PRIORITY=5
CONFIG_ZBUS=y
CONFIG_ZBUS_LOG_LEVEL_INF=y
CONFIG_ZBUS_CHANNEL_NAME=y
CONFIG_ZBUS_OBSERVER_NAME=y
CONFIG_ZBUS_RUNTIME_OBSERVERS=y
```

## boards/mec_assy6941_mec1743_qlj.overlay
```dts
/*
 * Copyright (c) 2025 Microchip Technology Inc.
 * SPDX-License-Identifier: Apache-2.0
 */

#include <zephyr/dt-bindings/gpio/gpio.h>
#include <zephyr/dt-bindings/gpio/microchip-xec-gpio.h>

/*
 * MEC5_ASSY6941 with MEC1743Q-LJ part.
 * JP8 1-2 GPIO055 (BSS_STRAP) pulled-down via 10K to ground selects
 *   Boot-ROM load from eSPI
 * JP7 No jumper
 * JP18 14-15 selects GPIO055 as SHD_nCS0
 * JP45 1-2 connects 1.8V
 * JP62 2-3 and JP68 3-4 VTR2 is powered by 1.8V
 * NOTE: VTR3 is always 1.8V
 *
 * GPIO175/CMP_VOUT1/PWM8_ALT on schematic, LED4 on silkscreen.
 */

&uart1 {
	current-speed = <115200>;
	status = "okay";
	pinctrl-0 = <&uart1_tx_gpio170 &uart1_rx_gpio171>;
	pinctrl-names = "default";
};
```

## boards/mec_assy6941_mec1743qsz.overlay
```dts
/*
 * Copyright (c) 2025 Microchip Technology Inc.
 * SPDX-License-Identifier: Apache-2.0
 */

#include <zephyr/dt-bindings/gpio/gpio.h>
#include <zephyr/dt-bindings/gpio/microchip-xec-gpio.h>

/*
 * MEC5_ASSY6941 with MEC1743Q-SZ part.
 * JP8 1-2 GPIO055 (BSS_STRAP) pulled-down via 10K to ground selects
 *   Boot-ROM load from eSPI
 * JP7 No jumper
 * JP18 14-15 selects GPIO055 as SHD_nCS0
 * JP45 1-2 connects 1.8V
 * JP62 2-3 and JP68 3-4 VTR2 is powered by 1.8V
 * NOTE: VTR3 is always 1.8V
 *
 * GPIO175/CMP_VOUT1/PWM8_ALT on schematic, LED4 on silkscreen.
 */

&uart1 {
	current-speed = <115200>;
	status = "okay";
	pinctrl-0 = <&uart1_tx_gpio170 &uart1_rx_gpio171>;
	pinctrl-names = "default";
};
```

## boards/mec_assy6941_mec1753_qlj.overlay
```dts
/*
 * Copyright (c) 2025 Microchip Technology Inc.
 * SPDX-License-Identifier: Apache-2.0
 */

#include <zephyr/dt-bindings/gpio/gpio.h>
#include <zephyr/dt-bindings/gpio/microchip-xec-gpio.h>

/*
 * MEC5_ASSY6941 with MEC1753Q-LJ part.
 * JP8 1-2 GPIO055 (BSS_STRAP) pulled-down via 10K to ground selects
 *   Boot-ROM load from eSPI
 * JP7 No jumper
 * JP18 14-15 selects GPIO055 as SHD_nCS0
 * JP45 1-2 connects 1.8V
 * JP62 2-3 and JP68 3-4 VTR2 is powered by 1.8V
 * NOTE: VTR3 is always 1.8V
 *
 * GPIO175/CMP_VOUT1/PWM8_ALT on schematic, LED4 on silkscreen.
 */

&uart1 {
	current-speed = <115200>;
	status = "okay";
	pinctrl-0 = <&uart1_tx_gpio170 &uart1_rx_gpio171>;
	pinctrl-names = "default";
};
```

## src/main.c
```c
/*
 * Copyright (c) 2025 Microchip Technology Inc.
 * SPDX-License-Identifier: Apache-2.0
 */

#include <errno.h>
#include <stdint.h>
#include <string.h>
#include <soc.h>
#include <device_mec5.h>
#include <mec_retval.h>

#include <zephyr/device.h>
#include <zephyr/devicetree.h>
#include <zephyr/kernel.h>
#include <zephyr/drivers/gpio.h>
#include <zephyr/drivers/led.h>
#include <zephyr/drivers/pinctrl.h>
#include <zephyr/drivers/spi.h>
#include <zephyr/sys/atomic.h>
#include <zephyr/sys/sys_io.h>
#include <zephyr/zbus/zbus.h>

#include <zephyr/logging/log_ctrl.h>
#include <zephyr/logging/log.h>
LOG_MODULE_REGISTER(main, CONFIG_APP_LOG_LEVEL);

#include <app_version.h>

#ifdef CONFIG_USE_APP_THREAD1
#include "app_thread1.h"
#endif
#ifdef CONFIG_USE_APP_THREAD2
#include "app_thread2.h"
#endif

struct version_msg {
	uint8_t major;
	uint8_t minor;
	uint16_t build;
};

struct acc_msg {
	int x, y, z;
};

/* ---- ZBUS ---- */
ZBUS_CHAN_DEFINE(version_chan,		/* Name */
		struct version_msg,	/* Message type */
		NULL,			/* validator */
		NULL,			/* user data */
		ZBUS_OBSERVERS_EMPTY,	/* observers */
		ZBUS_MSG_INIT(.major = 0, .minor = 1, .build = 2)
);

ZBUS_CHAN_DEFINE(acc_data_chan,		/* Name */
		struct acc_msg,		/* Message type */
		NULL,			/* validator */
		NULL,			/* user data */
		ZBUS_OBSERVERS(foo_lis, bar_sub),	/* observers */
		ZBUS_MSG_INIT(.x = 0, .y = 1, .z = 0)
);

bool simple_chan_validator(const void *msg, size_t msg_size)
{
	ARG_UNUSED(msg_size);

	const int *simple = msg;

	if ((*simple >= 0) && (*simple < 10)) {
		return true;
	}

	return false;
}

ZBUS_CHAN_DEFINE(simple_chan, /* Name */
		 int,         /* Message type */

		 simple_chan_validator, /* Validator */
		 NULL,                  /* User data */
		 ZBUS_OBSERVERS_EMPTY,  /* observers */
		 0                      /* Initial value is 0 */
);

static void listener_callback_example(const struct zbus_channel *chan)
{
	const struct acc_msg *acc = zbus_chan_const_msg(chan);

	LOG_INF("From listener -> Acc x=%d, y=%d, z=%d", acc->x, acc->y, acc->z);
}

ZBUS_LISTENER_DEFINE(foo_lis, listener_callback_example);
ZBUS_SUBSCRIBER_DEFINE(bar_sub, 4);

static void subscriber_task(void)
{
	const struct zbus_channel *chan;

	while (!zbus_sub_wait(&bar_sub, &chan, K_FOREVER)) {
		struct acc_msg acc;

		if (&acc_data_chan == chan) {
			zbus_chan_read(&acc_data_chan, &acc, K_MSEC(500));

			LOG_INF("From subscriber -> Acc x=%d, y=%d, z=%d", acc.x, acc.y, acc.z);
		}
	}
}

K_THREAD_DEFINE(subscriber_task_id, CONFIG_MAIN_STACK_SIZE, subscriber_task, NULL, NULL, NULL, 3, 0,
		0);

static bool print_channel_data_iterator(const struct zbus_channel *chan, void *user_data)
{
	int *count = user_data;

	LOG_INF("%d - Channel %s:", *count, zbus_chan_name(chan));
	LOG_INF("      Message size: %d", zbus_chan_msg_size(chan));
	LOG_INF("      Observers:");

	++(*count);

	struct zbus_channel_observation *observation;

	for (int16_t i = chan->data->observers_start_idx, limit = chan->data->observers_end_idx;
	     i < limit; ++i) {
		STRUCT_SECTION_GET(zbus_channel_observation, i, &observation);

		__ASSERT(observation != NULL, "observation must be not NULL");

		LOG_INF("      - %s", observation->obs->name);
	}

	struct zbus_observer_node *obs_nd, *tmp;

	SYS_SLIST_FOR_EACH_CONTAINER_SAFE(&chan->data->observers, obs_nd, tmp, node) {
		LOG_INF("      - %s", obs_nd->obs->name);
	}

	return true;
}

static bool print_observer_data_iterator(const struct zbus_observer *obs, void *user_data)
{
	int *count = user_data;

	LOG_INF("%d - %s %s", *count,
		obs->type == ZBUS_OBSERVER_LISTENER_TYPE ? "Listener" : "Subscriber",
		zbus_obs_name(obs));

	++(*count);

	return true;
}

/* ---- Global variables ---- */
static volatile uint32_t spin_val;
static volatile int ret_val;

/* ---- prototypes ---- */
static void spin_on(uint32_t id, int rval);

static int zbus_test1(void);

int main(void)
{
	int ret = 0;

	LOG_INF("app_zbus sample: board: %s", DT_N_P_compatible_IDX_0);

	zbus_test1();

#ifdef CONFIG_USE_APP_THREAD1
	ret = app_thread1_create(0);
	LOG_INF("Thread 1 create returned (%d)", ret);
	if (ret == 0) {
		LOG_INF("Thread 1 TID = %p", app_thread1_get_tid());
	}
#endif
#ifdef CONFIG_USE_APP_THREAD2
	/* Create thread but don't allow it start. Zephyr kernel will not put this
	 * thread in its to run queue until k_thread_start(k_tid_t thread_id) is called.
	 */
	ret = app_thread2_create(UINT32_MAX);
	LOG_INF("Thread 2 create returned (%d)", ret);
	if (ret == 0) {
		LOG_INF("Thread 2 TID = %p", app_thread2_get_tid());
	}
#endif

	LOG_INF("Application Done (%d)", ret);
	spin_on((uint32_t)__LINE__, 0);

	return 0;
}

static void spin_on(uint32_t id, int rval)
{
	spin_val = id;
	ret_val = rval;

	log_panic(); /* flush log buffers */

	while (spin_val) {
		k_sleep(K_MSEC(5000));
	}
}

static int zbus_test1(void)
{
	int err =0, value = 0, count = 0;
	struct acc_msg acc1 = {.x = 1, .y = 1, .z = 1};
	const struct version_msg *v = zbus_chan_const_msg(&version_chan);

	LOG_INF("Sensor sample started raw reading, version %u.%u-%u!", v->major, v->minor,
		v->build);

	LOG_INF("Channel list:");
	zbus_iterate_over_channels_with_user_data(print_channel_data_iterator, &count);

	count = 0;

	LOG_INF("Observers list:");
	zbus_iterate_over_observers_with_user_data(print_observer_data_iterator, &count);
	zbus_chan_pub(&acc_data_chan, &acc1, K_SECONDS(1));

	k_msleep(1000);

	acc1.x = 2;
	acc1.y = 2;
	acc1.z = 2;
	zbus_chan_pub(&acc_data_chan, &(acc1), K_SECONDS(1));

	value = 5;
	err = zbus_chan_pub(&simple_chan, &value, K_MSEC(200));

	if (err == 0) {
		LOG_INF("Pub a valid value to a channel with validator successfully.");
	}

	value = 15;
	err = zbus_chan_pub(&simple_chan, &value, K_MSEC(200));

	if (err == -ENOMSG) {
		LOG_INF("Pub an invalid value to a channel with validator successfully.");
	}

	return 0;
}
```

## src/app_thread1.c
```c
/*
 * Copyright (c) 2025 Microchip Technology Inc.
 * SPDX-License-Identifier: Apache-2.0
 */

#include <errno.h>
#include <stdint.h>
#include <string.h>
#include <soc.h>
#include <device_mec5.h>
#include <mec_retval.h>

#include <zephyr/device.h>
#include <zephyr/devicetree.h>
#include <zephyr/kernel.h>
#include <zephyr/drivers/gpio.h>
#include <zephyr/drivers/led.h>
#include <zephyr/drivers/pinctrl.h>
#include <zephyr/drivers/spi.h>
#include <zephyr/sys/atomic.h>
#include <zephyr/sys/sys_io.h>
#include <zephyr/zbus/zbus.h>

#include <zephyr/logging/log_ctrl.h>
#include <zephyr/logging/log.h>
LOG_MODULE_DECLARE(main);

#include <app_version.h>

#include "app_thread1.h"
#include "app_thread2.h"

BUILD_ASSERT(CONFIG_APP_THREAD1_STACK_SIZE >= 256, "Thread 1 stack size < 256 bytes");

static struct k_thread app_thread1_data;
static k_tid_t app_thread1_tid;

K_THREAD_STACK_DEFINE(app_thread1_stack_area, CONFIG_APP_THREAD1_STACK_SIZE);

static void app_thread1(void *p1, void *p2, void *p3);

int app_thread1_create(uint32_t start_delay_ms)
{
	k_timeout_t start_delay_ticks = K_NO_WAIT;

	if (start_delay_ms) {
		if (start_delay_ms == UINT32_MAX) {
			start_delay_ticks = K_FOREVER;
		} else {
			start_delay_ticks = K_MSEC(start_delay_ms);
		}
	}

	app_thread1_tid = k_thread_create(&app_thread1_data, app_thread1_stack_area,
					  K_THREAD_STACK_SIZEOF(app_thread1_stack_area),
					  app_thread1,
					  NULL, NULL, NULL,
					  CONFIG_APP_THREAD1_PRIORITY,
					  0, start_delay_ticks);

	if (app_thread1_tid == NULL) {
		return -ESRCH;
	}

	return 0;
}

k_tid_t app_thread1_get_tid(void)
{
	return app_thread1_tid;
}

static void app_thread1(void *p1, void *p2, void *p3)
{
	uint32_t start_other_threads_count = 10;
	bool other_threads_started = false;

	LOG_INF("T1 entry: params %p %p %p", p1, p2, p3);

	while (1) {
		LOG_INF("T1 Sleep");
		k_sleep(K_MSEC(1000));
		LOG_INF("T1 wake");
		if (!other_threads_started) {
			start_other_threads_count--;
			if (!start_other_threads_count) {
				LOG_INF("T1: Start Thread 2");
				other_threads_started = true;
				k_thread_start(app_thread2_get_tid());
			}
		}
	}
}
```

## src/app_thread1.h
```c
/*
 * Copyright (c) 2025 Microchip Technology Inc.
 * SPDX-License-Identifier: Apache-2.0
 */

#ifndef _APP_THREAD1_H
#define _APP_THREAD1_H

#include <stdint.h>
#include <zephyr/kernel.h>

int app_thread1_create(uint32_t start_delay_ms);
k_tid_t app_thread1_get_tid(void);

#endif /* _APP_THREAD1_H */
```

## src/app_thread2.c
```c
/*
 * Copyright (c) 2025 Microchip Technology Inc.
 * SPDX-License-Identifier: Apache-2.0
 */

#include <errno.h>
#include <stdint.h>
#include <string.h>
#include <soc.h>
#include <device_mec5.h>
#include <mec_retval.h>

#include <zephyr/device.h>
#include <zephyr/devicetree.h>
#include <zephyr/kernel.h>
#include <zephyr/drivers/gpio.h>
#include <zephyr/drivers/led.h>
#include <zephyr/drivers/pinctrl.h>
#include <zephyr/drivers/spi.h>
#include <zephyr/sys/atomic.h>
#include <zephyr/sys/sys_io.h>
#include <zephyr/zbus/zbus.h>

#include <zephyr/logging/log_ctrl.h>
#include <zephyr/logging/log.h>
LOG_MODULE_DECLARE(main);

#include <app_version.h>

BUILD_ASSERT(CONFIG_APP_THREAD2_STACK_SIZE >= 256, "Thread 2 stack size < 256 bytes");

static struct k_thread app_thread2_data;
static k_tid_t app_thread2_tid;

K_THREAD_STACK_DEFINE(app_thread2_stack_area, CONFIG_APP_THREAD2_STACK_SIZE);

static void app_thread2(void *p1, void *p2, void *p3);

int app_thread2_create(uint32_t start_delay_ms)
{
	k_timeout_t start_delay_ticks = K_NO_WAIT;

	if (start_delay_ms) {
		if (start_delay_ms == UINT32_MAX) {
			start_delay_ticks = K_FOREVER;
		} else {
			start_delay_ticks = K_MSEC(start_delay_ms);
		}
	}

	app_thread2_tid = k_thread_create(&app_thread2_data, app_thread2_stack_area,
					  K_THREAD_STACK_SIZEOF(app_thread2_stack_area),
					  app_thread2,
					  NULL, NULL, NULL,
					  CONFIG_APP_THREAD2_PRIORITY,
					  0, start_delay_ticks);

	if (app_thread2_tid == NULL) {
		return -ESRCH;
	}

	return 0;
}

k_tid_t app_thread2_get_tid(void)
{
	return app_thread2_tid;
}

static void app_thread2(void *p1, void *p2, void *p3)
{
	LOG_INF("T2 entry: params %p %p %p", p1, p2, p3);

	while (1) {
		LOG_INF("T2 Sleep");
		k_sleep(K_MSEC(2000));
		LOG_INF("T2 wake");
	}
}
```

## src/app_thread2.h
```c
/*
 * Copyright (c) 2025 Microchip Technology Inc.
 * SPDX-License-Identifier: Apache-2.0
 */

#ifndef _APP_THREAD2_H
#define _APP_THREAD2_H

#include <stdint.h>
#include <zephyr/kernel.h>

int app_thread2_create(uint32_t start_delay_ms);
k_tid_t app_thread2_get_tid(void);

#endif /* _APP_THREAD2_H */
```
